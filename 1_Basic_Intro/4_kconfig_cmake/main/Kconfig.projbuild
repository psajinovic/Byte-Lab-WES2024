## 1_Basic_Intro/4_kconfig_cmake/main/Kconfig.projbuild
```kconfig
menu "WES additional"
 
    config GPIO_LED
         int "Select GPIO LED"
         default 14
         help
             Enter GPIO for LED
 
         endmenu
```
